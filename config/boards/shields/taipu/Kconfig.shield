## config/boards/shields/taipu/Kconfig.shield
```kconfig
config SHIELD_TAIPU_LEFT
    def_bool $(shields_list_contains,Taipu_left)
    
config SHIELD_TAIPU_RIGHT
    def_bool $(shields_list_contains,Taipu_right)
```
